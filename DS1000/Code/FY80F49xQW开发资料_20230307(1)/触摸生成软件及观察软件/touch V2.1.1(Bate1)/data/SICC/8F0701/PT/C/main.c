/***********************************************************************
方案说明：
***********************************************************************/
/**********************************************************************/
/*修改说明*/

/**********************************************************************/
/**********************************************************************/
/**********************************************************************/
/*头文件*/
#include <cms.h>
#include "main.h"
#include "delay.h"
#include "mytype.h"
#include "Touch_Kscan_Library.h"
#include "REL_Sender.h"
/**********************************************************************/
/*全局变量声明*/
/**********************************************************************/
volatile unsigned char tcount;

/**********************************************************************/
/**********************************************************************/
/***********************************************************************
子函数功能：上电初始化系统寄存器
入口参数：
返回数据：
备注：
***********************************************************************/
void Init_ic (void)
{
	asm("clrwdt");
	PORTA = 0;
	PORTB = 0;
	PORTC = 0;
	PORTD = 0;
	INTCON = 0x00;
	asm("clrwdt");
	OPTION_REG = 0;
	PIR1 = 0;
	PIR2 = 0;
	WDTCON = 0x01;
	TRISA = 0B00000000;
	TRISB = 0B00000000;
	TRISC = 0x00;
	TRISD = 0x03;
	
	OSCCON = 0x71;
	PIE1 = 0;
	PIE2 = 0;
	IOCB = 0;
	WPUA = 0;
	WPUB = 0;
	WPUC = 0;
	WPUD = 0;
}
/***********************************************************************
函数功能：初始上电RAM赋值
入口参数：
返回数据：
备注：
***********************************************************************/
void Init_ram (void)
{
	asm("clrwdt");
	PIE1 = 0B00000010;
	PR2 = 250;//32M下将TMR2设置为125us中断
	T2CON = 5;//使能定时器2
	
	INTCON = 0xC0;//使能中断
	INTCON2 = 0x01;//TM2为高优先级中断
}
/***********************************************************************
函数功能：系统寄存器刷新
入口参数：
返回数据：
备注：
***********************************************************************/
void Sys_set (void)
{
	asm("clrwdt");
	OPTION_REG = 0;
	WDTCON = 0x01;
	TRISA = 0B00000000;
	TRISB = 0B00000000;
	TRISC = 0x00;
	TRISD = 0x00;
	PIE1 = 0B00000010;
	PR2 = 250;
	INTCON = 0XC0;
	INTCON2 = 0x01;//TM2为高优先级中断
	if(5 != T2CON)
		T2CON = 5;
}

/***********************************************************************
//键处理函数
***********************************************************************/
void Kscan()
{
	static unsigned int KeyOldFlag = 0;
	unsigned int i = (unsigned int)((g_KeyFlag[1]<<8) | g_KeyFlag[0]);
	if(i)
	{
		if(i != KeyOldFlag)
		{
			KeyOldFlag = i;//有检测到按键
			if(0x1 & i){}
			else if(0x2 & i){}
			else if(0x4 & i){}
			else if(0x8 & i){}
		}
	}
	else
	{
		KeyOldFlag = 0;
	}
}

/***********************************************************************
函数功能：中断入口函数
***********************************************************************/
void interrupt time0(void)
{
	if(INTCON2 & 0x20)//若是高优先级中断
	{
		if(TMR2IF)
		{
			TMR2IF = 0;
			tcount ++;
		}
	}
	else if(PIR2 & 0x40)//触摸中断,PIE2的bit6为触摸中断使能位，不能在main主循环和中断里操作
	{
		PIR2 &= (~0X40);//需要清触摸中断标志
		__CMS_TouchKeyValue();
	}
}

/***********************************************************************
main主函数
***********************************************************************/
void main(void)
{
	/******************************************************************/
	Init_ic();
	Delay_nms(200);//上电延时200ms
	Init_ram();//上电给初值
	while(1)
	{
		OSCCON = 0x71;
		if(tcount >= 32)
		{
			tcount = 0;//主程序循环4ms
			Sys_set();

			#if (REL_SENDER_ENABLE == 1)//调试宏定义是否为1
				REL_SenderLoop();//发码子程序
			#endif
			
			__CMS_CheckTouchKey();//扫描按键
			Kscan();//按键处理
		}
	}
}
/**********************************************************************/



