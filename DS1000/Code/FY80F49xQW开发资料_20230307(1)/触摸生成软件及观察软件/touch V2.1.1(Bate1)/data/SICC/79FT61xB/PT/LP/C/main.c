/***********************************************************************
方案说明：
***********************************************************************/
/**********************************************************************/
/*修改说明*/

/**********************************************************************/
/**********************************************************************/
/**********************************************************************/
/*头文件*/
#include <cms.h>
#include "main.h"
#include "delay.h"
#include "mytype.h"
#include "Touch_Kscan_Library.h"
#include "REL_Sender.h"
/**********************************************************************/
/*全局变量声明*/
/**********************************************************************/
volatile unsigned char tcount;
volatile unsigned int SleepTimec;


/**********************************************************************/
/**********************************************************************/
/***********************************************************************
子函数功能：上电初始化系统寄存器
入口参数：
返回数据：
备注：
***********************************************************************/
void Init_ic (void)
{
	asm("clrwdt");
	PORTA = 0;
	PORTB = 0;
	PORTC = 0;
	INTCON = 0x00;
	PIR1 = 0;
	PIR2 = 0;
	WDTCON = 0x01;
	TRISA = 0B00000000;
	TRISB = 0B00000000;
	TRISC = 0B00000000;
	//OPTION_REG = 0;
	asm("clrwdt");
	OPTION_REG |= 0X07;
	TMR0 = 0;
	OPTION_REG |= 0X08;
	asm("clrwdt");
	OPTION_REG = 0B00001011;
	asm("clrwdt");
	OSCCON = 0x71;
	PIE1 = 0;
	PIE2 = 0;
	WPUA = 0;
	WPUB = 0;
	WPUC = 0;
}
/***********************************************************************
函数功能：初始上电RAM赋值
入口参数：
返回数据：
备注：
***********************************************************************/
void Init_ram (void)
{
	asm("clrwdt");
	PIE2 = 0;
	PIE1 = 0B00000010;
	PR2 = 250;				//8M下将TMR2设置为125us中断
	T2CON = 4;				//使能定时器2
	INTCON = 0XC0;			//使能中断
}
/***********************************************************************
函数功能：系统寄存器刷新
入口参数：
返回数据：
备注：
***********************************************************************/
void Sys_set (void)
{
	asm("clrwdt");
	WDTCON = 0x01;
	TRISA = 0B00000000;
	TRISB = 0B00000000;
	TRISC = 0B00000000;
	WPUA = 0;
	WPUB = 0;
	WPUC = 0;
	PIE1 = 0B00000010;
	PR2 = 250;
	INTCON = 0XC0;
	if(4 != T2CON)
		T2CON = 4;
}

/***********************************************************
键处理函数
***********************************************************/
void Kscan(void)
{
	static unsigned char KeyOldFlag = 0;
	
	if(KeyFlag)
	{
		SleepTimec = 0;
		KeyOldFlag ^= KeyFlag;
		if(KeyOldFlag)
		{
			if(0x1&KeyOldFlag){}
			if(0x2&KeyOldFlag){}
			if(0x4&KeyOldFlag){}
			if(0x8&KeyOldFlag){}
		}
		
		KeyOldFlag = KeyFlag;
	}
	else
	{
		KeyOldFlag = 0;
	}
}

/***********************************************************************
函数功能：Sleep_On
***********************************************************************/
void Sleep_On(void)
{
	PIE2 = 0B00000000;
	PIE1 = 0B00000000;
	PIR1 = 0;
	PIR2 = 0;
	T2CON = 0;
	INTCON = 0x00;
	INTCON = 0x00;
	INTCON = 0x00;
	asm("clrwdt");
	OPTION_REG |= 0X07;
	TMR0 = 0;
	OPTION_REG |= 0X08;
	asm("clrwdt");
	OPTION_REG = 0B00001011;
	asm("clrwdt");
	WDTCON = 0x01;
	PORTA = 0;
	PORTB = 0;
	PORTC = 0;
	TRISA = 0B00000000;
	TRISB = 0B00000000;
	TRISC = 0B00000000;
	
	asm("clrwdt");
	asm("sleep");
	asm("nop");
	asm("nop");
}
/***********************************************************************
函数功能：Sleep_Set
***********************************************************************/
void Sleep_Set(void)
{
	if(++SleepTimec >= 500)
	{
		SleepTimec = 0;
		while(1)
		{
			asm("clrwdt");
			WDTCON = 0x01;
			TRISA = 0x00;
			TRISB = 0x00;
			TRISC = 0x00;
			PIE1 = 0B00000000;
			INTCON = 0x00;
			T2CON = 0;
			KeySleepStr = 1;
			__CMS_CheckTouchKey();	//扫描按键
			if(KeyOnceOver)
			{
				KeyOnceOver = 0;
				if(!KeyOnceHave)
				{
					Sleep_On();
				}
				else
				{
					Sys_set();
					KeySleepStr = 0;
					break;
				}
			}
		}
	}
}

/***********************************************************************
函数功能：中断入口函数
***********************************************************************/
void interrupt time0(void)
{
	if(TMR2IF)
	{
		TMR2IF = 0;
		tcount ++;
	}
}

/***********************************************************************
main主函数
***********************************************************************/
void main(void)
{
	/******************************************************************/
	Init_ic();
	Delay_nms(200);
	Init_ram();//上电给初值
	
	while(1)
	{
		OSCCON = 0x71;
		if(tcount >= 32)
		{
			tcount = 0;//主程序循环4.0ms
			Sys_set();

			__CMS_CheckTouchKey();	//扫描按键
			Kscan();
			#if (REL_SENDER_ENABLE == 1)//调试宏定义是否为1
				REL_SenderLoop();//发码子程序
			#endif
			Sleep_Set();
		}
	}
}
/**********************************************************************/



