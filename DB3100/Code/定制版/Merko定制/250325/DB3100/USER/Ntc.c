#include "Ntc.h"

/**********局部变量**********/
const uint16_t R10K_TAB[] = //R25=10K?3% B25/50=4100K?3% 10K??//-20-105
{
    170,//-10
    180,//-9
    189,//-8
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    3714,//130
};

/**********全局变量**********/
int rel_temp;//实际温度
int set_temp;//设定温度
int ctrl_temp;//设定温度
uint16_t val;//adc的值
uint8_t res;//温度采样返回的状态

/*
*****************************************************************
 * 函数原型： int filter(void)
 * 功    能： 滑动平均值滤波
 * 输    出： 滤波后的值
*****************************************************************
*/
#define N 100//采集100次
int value_buf[N];//用于储存采集到的adc值
int i = 0;
int filter(void)
{
    char count;
    long sum = 0;

    HAL_ADC_Start(&hadc);//开始读取adc的值
    value_buf[i++] = HAL_ADC_GetValue(&hadc);//将adc的值储存
    if (i == N)//加入读了100组就从新开始
    {
        i = 0;
    }
    for (count = 0; count < N; count++)
    {
        sum += value_buf[count];//100组相加
    }
    if(value_buf[99] == 0)//如果没有读到100组就用第一次读到的数
        return value_buf[0];
    else//读到100组后
        return (int)(sum / N);//输出平均值
}

/*
*****************************************************************
 * 函数原型： uint16_t func_get_ntc_temp(uint16_t value_adc)
 * 功    能： 计算出Ntc的温度
 * 输    入:  value_adc:adc读到的值
 * 参    数： uint16_t value_adc
*****************************************************************
*/
#define SHORT_CIRCUIT_THRESHOLD 15
#define OPEN_CIRCUIT_THRESHOLD 4096
uint8_t index_l, index_r ; 
int temp = 0;
uint16_t func_get_ntc_temp(uint16_t value_adc)
{
    uint8_t r10k_tab_size = 141;
   
    if(value_adc <= SHORT_CIRCUIT_THRESHOLD)
    {
        return 1;
    }
    else if(value_adc >= OPEN_CIRCUIT_THRESHOLD)
    {
        return 2;
    }
    else if(value_adc < R10K_TAB[0])
    {
        return 3;
    }

    else if(value_adc > R10K_TAB[r10k_tab_size - 1])
    {
        return 4;
    }

    index_l = 0;
    index_r = r10k_tab_size - 1;
    for(; index_r - index_l > 1;)
    {
        if((value_adc <= R10K_TAB[index_r]) && (value_adc > R10K_TAB[(index_l + index_r) % 2 == 0 ? (index_l + index_r) / 2 : (index_l + index_r) / 2 ]))
        {
            index_l = (index_l + index_r) % 2 == 0 ? (index_l + index_r) / 2 : (index_l + index_r) / 2 ;
        }
        else
        {
            index_r = (index_l + index_r) / 2;
        }
    }
    if(R10K_TAB[index_l] == value_adc)
    {
        temp = (((int)index_l) - 10) * 10; //rate *10
    }
    else if(R10K_TAB[index_r] == value_adc)
    {
        temp = (((int)index_r) - 10) * 10; //rate *10
    }
    else
    {
        if(R10K_TAB[index_r] - R10K_TAB[index_l] == 0)
        {
			
            temp = (((int)index_l) - 10) * 10; //rate *10
        }
        else
        {
            temp = (((int)index_l) - 10) * 10 + ((value_adc - R10K_TAB[index_l] ) * 100 + 5) / 10 / (R10K_TAB[index_r] - R10K_TAB[index_l]);
        }
    }

/******************温度补偿*********************/
	rel_temp = temp - 6;//实际温度等于测得温度

	return 0;
}

/*
*****************************************************************
 * 函数原型：uint16_t Get_ADCVal(int16_t temp)
 * 功    能：计算当前温度的adc值
 * 输    入：temp：当前温度
 * 输    出：ADC值
 * 参    数：uint16_t temp
*****************************************************************
*/
uint16_t Get_ADCVal(int16_t temp)
{
	int16_t adc,adc1;
	float val2;
	int16_t val3,val1;
	
	val3 = ((temp+6)/10)+10;
	val2 = (float)((temp+6)%10)/10;
	
	val1 = (((temp+6)+10)/10)+10;
	
	adc = R10K_TAB[val3];
	adc1 = R10K_TAB[val1];
	return adc+((adc1-adc)*val2);
}

/*
*****************************************************************
 * 函数原型： void Read_Temp(void)
 * 功    能： 读取温度-10ms
*****************************************************************
*/
void Read_Temp(void)
{
    static uint8_t Num;
    Num++;
    val = filter();//滤波获取adc的滑动平均值
    if(Num == 100)//1S
    {
        res = func_get_ntc_temp(val);//计算温度
        Num = 0;
    }
}
