#include "Drv_PT1000.h"

/*
-50-390摄氏度
*/
#define PT1000_Tab_Size 441
const float Temp_map[PT1000_Tab_Size]=
{
803.06,
807.03,
811.00,
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2432.94,
2436.40
};

/**********全局变量**********/
#define OP_Value	6.8//放大系数
#define Vref_3V3	3.30//3.3V电压
#define K1			0.2327367//电阻基准系数
#define Vref		2.494//参考电压
#define IIR(x,y) (x)=((x) * 9 + (y)) / 10//滤波
uint16_t ADC_Val[AD_LEN];//adc的值

#define N 100//采集100次
int ADCvalue_Buf[AD_LEN][N];//用于储存采集到的adc值
uint8_t j[AD_LEN];
/**
 * @brief 滑动平均值滤波
 * 
 * @param i adc的通道
 * @return int 滤波后的值
 */
int Filter_ADC(uint8_t i)
{
    uint8_t count;
    long sum = 0;

	ADCvalue_Buf[i][j[i]++] = ADC_Val[i];
	
    if (j[i] == N)//加入读了100组就从新开始
    {
        j[i] = 0;
    }
	for (count = 0; count < N; count++)
	{
		sum += ADCvalue_Buf[i][count];//100组相加
	}
    if(ADCvalue_Buf[i][N-1] == 0)//如果没有读到100组就用第一次读到的数
        return ADCvalue_Buf[i][0];
    else//读到100组后
        return (int)(sum / N);//输出平均值
}

// float temp_correct[AD_LEN];//温度系数
float ADC_Val_Avg[AD_LEN];//温度的值
float AD_T[AD_LEN];//ADC计算后的电压值
float PT_VALUE_TEMP[AD_LEN];//阻值
/**
 * @brief 计算阻值
 * 
 */
void AFE_Sample_Handler(void)
{
    // temp_correct = 1.00167f;
	// temp_correct1 = 1.0f;

	for (uint8_t  i = 0; i < AD_LEN; i++)
	{
		ADC_Val_Avg[i] = Filter_ADC(i);
        if(ADC_Val_Avg[i] <= 3700)//最低限制，目前数值还很大，3210.81，将以下的值滤掉
            ADC_Val_Avg[i] = 3700;
		AD_T[i] = 3.3f/((3.3*ADC_Val_Avg[i]/4096)/30000)-30000;//计算电压值
		PT_VALUE_TEMP[i] = AD_T[i];//计算电阻值
	}
}

#define SHORT_CIRCUIT_THRESHOLD 723//短路阈值
#define OPEN_CIRCUIT_THRESHOLD 2810//开路阈值

/**
 * @brief 查表
 * 
 * @param tmp 计算出的电阻值
 * @return int 温度R
 */
int AFE_GetTemperature(float value_R)
{
	int temp = 0;
    uint16_t index_l, index_r;
	if (value_R <= SHORT_CIRCUIT_THRESHOLD)
    {
        return 1;//短路返回的错误码
    }
    else if (value_R >= OPEN_CIRCUIT_THRESHOLD)
    {
        return 2;//开路返回的错误码
    }
    else if (value_R < Temp_map[0])
    {
        return 3;//超出下标的错误码
    }

    else if (value_R > Temp_map[PT1000_Tab_Size - 1])
    {
        return 4;//超出上限的错误码
    }
	index_l = 0;
    index_r = PT1000_Tab_Size - 1;

	for (; index_r - index_l > 1;)
    {
        if ((value_R <= Temp_map[index_r]) && (value_R > Temp_map[(index_l + index_r) % 2 == 0 ? (index_l + index_r) / 2 : (index_l + index_r) / 2]))
        {
            index_l = (index_l + index_r) % 2 == 0 ? (index_l + index_r) / 2 : (index_l + index_r) / 2;
        }
        else
        {
            index_r = (index_l + index_r) / 2;
        }
    }

	if (Temp_map[index_l] == value_R)
    {
        temp = (((int)index_l) - 48) * 10; // rate *10
    }
    else if (Temp_map[index_r] == value_R)
    {
        temp = (((int)index_r) - 48) * 10; // rate *10
    }
    else
    {
        if (Temp_map[index_r] - Temp_map[index_l] == 0)
        {
            temp = (((int)index_l) - 48) * 10; // rate *10
        }
        else
        {
            temp = (((int)index_l) - 48) * 10 + ((value_R - Temp_map[index_l]) * 100 + 5) / 10 / (Temp_map[index_r] - Temp_map[index_l]);
        }
    }
	return temp;
}


/**
 * @brief 查表读ADC值
 * 
 * @param temp 温度
 * @return float adc的值
 */
float Get_ADCVal(int16_t temp)
{
	float adc_Val;
	if(temp < 0)//小于0摄氏度
	{
		adc_Val  =  Temp_map[220 + temp];
	}
	else if(temp >= 0 && temp < 1000)
	{
		adc_Val = Temp_map[220 + temp];
	}
	else if(temp >= 1000)
	{
		adc_Val = Temp_map[1220 + (temp-1000)/10];
	}
	return adc_Val;
}

/*
*****************************************************************
 * 函数原型：void Read_Temp(float dT)
 * 功    能：读取温度-10ms
*****************************************************************
*/
void Read_Temp(float dT)
{
	static float T;
	
	T += dT;
	AFE_Sample_Handler();//计算阻值

	Work_Num[2].Temp.Mesa = AFE_GetTemperature(PT_VALUE_TEMP[0]);
    Work_Num[0].Temp.Mesa = AFE_GetTemperature(PT_VALUE_TEMP[2]);
	Work_Num[3].Temp.Mesa = AFE_GetTemperature(PT_VALUE_TEMP[4]);
    Work_Num[1].Temp.Mesa = AFE_GetTemperature(PT_VALUE_TEMP[6]);

	if(T >= 1.0f)
	{
		// if(PT_VALUE_TEMP[0] < 913.733)//假如没有插入外部探头
		// 	Temp.Rel = Temp.Mesa;//真实温度显示台面温度
		// else//假如插入外部探头
		// 	Temp.Rel = Temp.Outside;//真实温度显示外部探头测的温度
		T = 0;
	}
}

/**
 * @brief ADC和DMA的初始化
 * 
 */
void ADCDMA_Init(void)
{
    HAL_ADCEx_Calibration_Start(&hadc1);//校准
	HAL_ADC_Start_DMA(&hadc1, (uint32_t *)ADC_Val, AD_LEN);//用DMA获取ADC的值
	for(uint8_t i = 0; i < 200; i++)
	{
		AFE_Sample_Handler();//计算阻值
		Read_Temp(0.6f);
	}
}


/**
 * @brief PT1000任务
 * 
 */
void PT1000_Task(void *p)
{
    TickType_t xLastWakeTime;//刚开始唤醒的时间
    xLastWakeTime = xTaskGetTickCount ();

    /**********初始化ADC_DMA***********/
    ADCDMA_Init();
    
    while(1)
    {
        Read_Temp(0.1f);
        vTaskDelayUntil(&xLastWakeTime, 100);
    }
}

