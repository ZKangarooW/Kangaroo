#include "Drv_NTC.h"

/**********局部变量**********/
const uint16_t R100K_TAB[] = //R25=100K B25=3950K -25-150
{
//    91,//-25
//    97,//-24
//    103,//-23
//    109,//-22
//    115,//-21
    122,//-20
    129,//-19
    137,//-18
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    3874,//150
};

/**********全局变量**********/
uint16_t ADC_Val;//adc的值
uint8_t NTC_Res;//温度采样返回的状态

/*
*****************************************************************
 * 函数原型： int Filter_ADC(void)
 * 功    能： 滑动平均值滤波
 * 输    出： 滤波后的值
*****************************************************************
*/
#define N 100//采集100次
int ADCvalue_Buf[N];//用于储存采集到的adc值
int i = 0;
int Filter_ADC(void)
{
    char count;
    long sum = 0;
    
    #if(Integration_TYPE <=1)//设置成四联和六联时
    HAL_ADC_Start(&hadc1);//开始读取adc的值
    ADCvalue_Buf[i++] = HAL_ADC_GetValue(&hadc1);//将adc的值储存
    #elif(Integration_TYPE == 2)//设置成八联时
    HAL_ADC_Start(&hadc1);//开始读取adc的值
    ADCvalue_Buf[i++] = HAL_ADC_GetValue(&hadc1);//将adc的值储存
    #endif
    if (i == N)//加入读了100组就从新开始
    {
        i = 0;
    }
    for (count = 0; count < N; count++)
    {
        sum += ADCvalue_Buf[count];//100组相加
    }
    if(ADCvalue_Buf[99] == 0)//如果没有读到100组就用第一次读到的数
        return ADCvalue_Buf[0];
    else//读到100组后
        return (int)(sum / N);//输出平均值
}

/*
*****************************************************************
 * 函数原型： uint16_t Get_Ntc_Temp(uint16_t value_adc)
 * 功    能： 计算出Ntc的温度
 * 输    入:  value_adc:adc读到的值
 * 参    数： uint16_t value_adc
*****************************************************************
*/
#define SHORT_CIRCUIT_THRESHOLD 15
#define OPEN_CIRCUIT_THRESHOLD 4096
uint8_t index_l, index_r ;
uint16_t Get_Ntc_Temp(uint16_t value_adc)
{
    uint8_t R100k_Tab_Size = 171;
    int temp = 0;
    if(value_adc <= SHORT_CIRCUIT_THRESHOLD)
    {
        return 1;
    }
    else if(value_adc >= OPEN_CIRCUIT_THRESHOLD)
    {
        return 2;
    }
    else if(value_adc < R100K_TAB[0])
    {
        return 3;
    }

    else if(value_adc > R100K_TAB[R100k_Tab_Size - 1])
    {
        return 4;
    }

    index_l = 0;
    index_r = R100k_Tab_Size - 1;
    for(; index_r - index_l > 1;)
    {
        if((value_adc <= R100K_TAB[index_r]) && (value_adc > R100K_TAB[(index_l + index_r) % 2 == 0 ? (index_l + index_r) / 2 : (index_l + index_r) / 2 ]))
        {
            index_l = (index_l + index_r) % 2 == 0 ? (index_l + index_r) / 2 : (index_l + index_r) / 2 ;
        }
        else
        {
            index_r = (index_l + index_r) / 2;
        }
    }
    if(R100K_TAB[index_l] == value_adc)
    {
        temp = (((int)index_l) - 20) * 10; //rate *10
    }
    else if(R100K_TAB[index_r] == value_adc)
    {
        temp = (((int)index_r) - 20) * 10; //rate *10
    }
    else
    {
        if(R100K_TAB[index_r] - R100K_TAB[index_l] == 0)
        {
            temp = (((int)index_l) - 20) * 10; //rate *10
        }
        else
        {
            temp = (((int)index_l) - 20) * 10 + ((value_adc - R100K_TAB[index_l] ) * 100 + 5) / 10 / (R100K_TAB[index_r] - R100K_TAB[index_l]);
        }
    }

    /******************温度补偿*********************/
    Ture_Temp = temp;//测得温度赋值
    return 0;
}

/*
*****************************************************************
 * 函数原型： void Read_Temp(void)
 * 功    能： 读取温度-10ms
*****************************************************************
*/
void Read_Temp(void)
{
    static uint8_t Num;
    Num++;
    ADC_Val = Filter_ADC();//滤波获取adc的滑动平均值
    if(Num == 100)//1S
    {
        NTC_Res = Get_Ntc_Temp(ADC_Val);//计算温度
        Num = 0;
    }
}
