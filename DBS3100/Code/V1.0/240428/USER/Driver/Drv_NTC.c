#include "Drv_NTC.h"

/*
*********************加热**************
76  -> 78

85 -> 86.5

96 -> 98.3
*********************制冷**************
70 -> 73

50 -> 51.3

25 -> 
*/

/*
*********************加热**************
30 -》28.6
*********************制冷**************

*/


/**********局部变量声明*******/
const uint16_t R100K_TAB[399] = // 测温电阻=100K B25=3950K -25-150
    {
        67,   //-48
        72,   //-47
        77,   //-48
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        4093,
        4093};

/**********全局变量**********/
#define AD_LEN 2          // DMA获取长度
uint16_t ADC_Val[AD_LEN]; // adc的值 0:内部探头。 1：热盖的探头
uint16_t ADC_Val1, ADC_Val2;
#define N 50         // 采集N次
int ADCvalue_Buf[N]; // 用于储存采集到的adc值
int i = 0;
int ADCvalue_Buf1[N]; // 用于储存采集到的adc值
int j = 0;

/**
 * @brief 滑动平均值滤波
 *
 * @return int 滤波后的值
 */
int Filter_ADC(void)
{
    uint8_t count;
    long sum = 0;

    ADCvalue_Buf[i++] = ADC_Val[0]; // 将adc的值储存

    if (i == N) // 加入读了N组就从新开始
    {
        i = 0;
    }
    for (count = 0; count < N; count++)
    {
        sum += ADCvalue_Buf[count]; // N组相加
    }
    if (ADCvalue_Buf[N - 1] == 0) // 如果没有读到100组就用第一次读到的数
        return ADCvalue_Buf[0];
    else                       // 读到N组后
        return (int)(sum / N); // 输出平均值
}

/**
 * @brief 滑动平均值滤波
 *
 * @return int 滤波后的值
 */
int Filter_ADC1(void)
{
    uint8_t count;
    long sum = 0;

    ADCvalue_Buf1[j++] = ADC_Val[1]; // 将adc的值储存

    if (j == N) // 加入读了N组就从新开始
    {
        j = 0;
    }
    for (count = 0; count < N; count++)
    {
        sum += ADCvalue_Buf1[count]; // N组相加
    }
    if (ADCvalue_Buf1[N - 1] == 0) // 如果没有读到100组就用第一次读到的数
        return ADCvalue_Buf1[0];
    else                       // 读到N组后
        return (int)(sum / N); // 输出平均值
}

#define SHORT_CIRCUIT_THRESHOLD 15
#define OPEN_CIRCUIT_THRESHOLD 4096
uint16_t index_l, index_r;
/**
 * @brief 计算出Ntc的温度
 *
 * @param value_adc adc读到的值
 * @return uint16_t 温度或者状态
 */
uint16_t Get_Ntc_Temp(uint16_t value_adc)
{
    uint16_t R100k_Tab_Size = 399;
    int temp = 0;
    if (value_adc <= SHORT_CIRCUIT_THRESHOLD)
    {
        return 1;
    }
    else if (value_adc >= OPEN_CIRCUIT_THRESHOLD)
    {
        return 2;
    }
    else if (value_adc < R100K_TAB[0])
    {
        return 3;
    }

    else if (value_adc > R100K_TAB[R100k_Tab_Size - 1])
    {
        return 4;
    }

    index_l = 0;
    index_r = R100k_Tab_Size - 1;
    for (; index_r - index_l > 1;)
    {
        if ((value_adc <= R100K_TAB[index_r]) && (value_adc > R100K_TAB[(index_l + index_r) % 2 == 0 ? (index_l + index_r) / 2 : (index_l + index_r) / 2]))
        {
            index_l = (index_l + index_r) % 2 == 0 ? (index_l + index_r) / 2 : (index_l + index_r) / 2;
        }
        else
        {
            index_r = (index_l + index_r) / 2;
        }
    }
    if (R100K_TAB[index_l] == value_adc)
    {
        temp = (((int)index_l) - 48) * 10; // rate *10
    }
    else if (R100K_TAB[index_r] == value_adc)
    {
        temp = (((int)index_r) - 48) * 10; // rate *10
    }
    else
    {
        if (R100K_TAB[index_r] - R100K_TAB[index_l] == 0)
        {
            temp = (((int)index_l) - 48) * 10; // rate *10
        }
        else
        {
            temp = (((int)index_l) - 48) * 10 + ((value_adc - R100K_TAB[index_l]) * 100 + 5) / 10 / (R100K_TAB[index_r] - R100K_TAB[index_l]);
        }
    }

    return temp;
}

/*
*****************************************************************
 * 函数原型：uint16_t Get_ADCVal(int16_t temp)
 * 功    能：计算当前温度的adc值
 * 输    入：temp：当前温度
 * 输    出：ADC值
 * 参    数：uint16_t temp
*****************************************************************
*/
uint16_t Get_ADCVal(int16_t temp)
{
	int16_t adc,adc1;
	float val2;
	int16_t val3,val1;
	
	val3 = (temp/10)+48;
	val2 = (float)(temp%10)/10;
	
	val1 = ((temp+10)/10)+48;
	
	adc = R100K_TAB[val3];
	adc1 = R100K_TAB[val1];
	return adc+((adc1-adc)*val2);
}

/**
 * @brief ADC和DMA的初始化
 *
 */
void ADCDMA_Init(void)
{
    HAL_TIM_Base_Start_IT(&htim15);                        // 开启TIM3的定时，用于刷新
    HAL_ADC_Start_DMA(&hadc, (uint32_t *)ADC_Val, AD_LEN); // 用DMA获取adc值
    HAL_ADCEx_Calibration_Start(&hadc);
    HAL_Delay(1000);
    Temp.Rel = Get_Ntc_Temp(ADC_Val[0]); // 计算温度
    Temp.Display_Rel = Temp.Rel;         // 这段不加，每次开机都会先显示0
}

/**
 * @brief 温度校准
 *
 * @param temp 测得的adc值
 * @param t1 设定的温度值
 * @param n1 在t1下测到的温度值
 * @param t2 设定的温度值
 * @param n2 在t2下测到的温度值
 */
uint16_t Temp_Calibration(uint16_t temp,uint16_t t1, uint16_t n1, uint16_t t2, uint16_t n2)
{
    float x1, y1, x2, y2, a, b, y;
    
    x1 = Get_ADCVal(t1);
    y1 = Get_ADCVal(n1);
    x2 = Get_ADCVal(t2);
    y2 = Get_ADCVal(n2);
    
    a = (y2 - y1) / (x2 - x1);
    b = y1 - a * x1;
    
    y = a * temp + b;
    
    return y;
}
/**
 * @brief 读取温度
 *
 * @param dT 任务周期
 */
uint16_t ADC_R,ADC_R1;
void Read_Temp(float dT)
{
    static float T;
    T += dT;
    ADC_R = Filter_ADC();  // 滤波获取adc的滑动平均值
    ADC_R1 = Filter_ADC1(); // 滤波获取adc的滑动平均值(热盖）
    if (ADC_R1)//有热盖的情况下
    {
        ADC_Val1 = Temp_Calibration(ADC_R,570, 573, 750, 753);
        ADC_Val2 = Temp_Calibration(ADC_R1,570, 564, 750, 736);
    }
    else
    {
        if (!HALL1 && !HALL2)//低模块
        {
            ADC_Val1 = ADC_R;
        }
        else
        {
            ADC_Val1 = Temp_Calibration(ADC_R,570, 561, 750, 738);
        }
    }
    if (T >= 0.2f) // 1S
    {
        if (ADC_R1)//有热盖的情况下
        {
            Temp.HEAT_GAI = Get_Ntc_Temp(ADC_Val2); // 计算温度
        }
        Temp.Rel = Get_Ntc_Temp(ADC_Val1);      // 计算温度
        T = 0;
    }
}
