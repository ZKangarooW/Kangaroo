#include "Drv_NTC.h"

/*********局部变量**********/
const uint16_t R100K_TAB[401] = //R25=100K B25=3950K -25-150
{
	58,//-48
	63,//-47
	67,//-46
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	4093, 
	4093
};

/**********全局变量**********/
#define AD_LEN 2//DMA获取长度
uint16_t ADC_Val[AD_LEN];//adc的值 0:内部探头。 1：热盖的探头
uint16_t ADC_Val1,ADC_Val2;

/*
*****************************************************************
 * 函数原型：int Filter_ADC(void)
 * 功    能：中位值滤波法,连续采样N次（N取奇数），把N次采样值按大小排列，取中间值为本次有效值。
 * 输    出：滤波后的值
*****************************************************************
*/
#define N 9
int ADCvalue_Buf[N];//用于储存采集到的adc值
int Filter_ADC(void)
{  
	uint16_t count,i,j,temp;
	for(count=0;count<N;count++)
	{
		ADCvalue_Buf[count] = ADC_Val[0];//将adc的值储存
	}
	for(j=0;j<N-1;j++)
	{
		for(i=0;i<N-j;i++)
		{
			if(ADCvalue_Buf[i] >  ADCvalue_Buf[i+1])
			{
				temp = ADCvalue_Buf[i];
				ADCvalue_Buf [i]= ADCvalue_Buf[i+1];
				ADCvalue_Buf[i+1] = temp;
			}
		}
	}

	return ADCvalue_Buf[(N-1)/2];
}

///*
//*****************************************************************
// * 函数原型：int Filter_ADC(void)
// * 功    能：滑动平均值滤波
// * 输    出：滤波后的值
//*****************************************************************
//*/
//#define N1 50//采集100次
//int ADCvalue_Buf2[N1];//用于储存采集到的adc值
//int i = 0;
//int Filter_ADC2(void)
//{
//    uint8_t count;
//    long sum = 0;
//    
//    ADCvalue_Buf2[i++] = Filter_ADC();//将adc的值储存
//	
//    if (i == N1)//加入读了100组就从新开始
//    {
//        i = 0;
//    }
//    for (count = 0; count < N; count++)
//    {
//        sum += ADCvalue_Buf2[count];//100组相加
//    }
//    if(ADCvalue_Buf2[N-1] == 0)//如果没有读到100组就用第一次读到的数
//        return ADCvalue_Buf2[0];
//    else//读到100组后
//        return (int)(sum / N);//输出平均值
//}

/*
*****************************************************************
 * 函数原型：int Filter_ADC1(void)
 * 功    能：中位值滤波法,连续采样N次（N取奇数），把N次采样值按大小排列，取中间值为本次有效值。
 * 输    出：滤波后的值
*****************************************************************
*/
int ADCvalue_Buf1[N];//用于储存采集到的adc值
int Filter_ADC1(void)
{  
	uint16_t count,i,j,temp;
	for(count=0;count<N;count++)
	{
		ADCvalue_Buf1[count] = ADC_Val[1];//将adc的值储存
	}
	for(j=0;j<N-1;j++)
	{
		for(i=0;i<N-j;i++)
		{
			if(ADCvalue_Buf1[i] >  ADCvalue_Buf1[i+1])
			{
				temp = ADCvalue_Buf1[i];
				ADCvalue_Buf1 [i]= ADCvalue_Buf1[i+1];
				ADCvalue_Buf1[i+1] = temp;
			}
		}
	}
	return ADCvalue_Buf1[(N-1)/2];
}

/*
*****************************************************************
 * 函数原型：uint16_t Get_Ntc_Temp(uint16_t value_adc)
 * 功    能：计算出Ntc的温度
 * 输    入: value_adc:adc读到的值
 * 参    数：uint16_t value_adc
*****************************************************************
*/
#define SHORT_CIRCUIT_THRESHOLD 15
#define OPEN_CIRCUIT_THRESHOLD 4096
uint16_t index_l, index_r ;
uint16_t Get_Ntc_Temp(uint16_t value_adc)
{
    uint16_t R100k_Tab_Size = 401;
    int temp = 0;
    if(value_adc <= SHORT_CIRCUIT_THRESHOLD)
    {
        return 1;
    }
    else if(value_adc >= OPEN_CIRCUIT_THRESHOLD)
    {
        return 2;
    }
    else if(value_adc < R100K_TAB[0])
    {
        return 3;
    }

    else if(value_adc > R100K_TAB[R100k_Tab_Size - 1])
    {
        return 4;
    }

    index_l = 0;
    index_r = R100k_Tab_Size - 1;
    for(; index_r - index_l > 1;)
    {
        if((value_adc <= R100K_TAB[index_r]) && (value_adc > R100K_TAB[(index_l + index_r) % 2 == 0 ? (index_l + index_r) / 2 : (index_l + index_r) / 2 ]))
        {
            index_l = (index_l + index_r) % 2 == 0 ? (index_l + index_r) / 2 : (index_l + index_r) / 2 ;
        }
        else
        {
            index_r = (index_l + index_r) / 2;
        }
    }
    if(R100K_TAB[index_l] == value_adc)
    {
        temp = (((int)index_l) - 48) * 10; //rate *10
    }
    else if(R100K_TAB[index_r] == value_adc)
    {
        temp = (((int)index_r) - 48) * 10; //rate *10
    }
    else
    {
        if(R100K_TAB[index_r] - R100K_TAB[index_l] == 0)
        {
            temp = (((int)index_l) - 48) * 10; //rate *10
        }
        else
        {
            temp = (((int)index_l) - 48) * 10 + ((value_adc - R100K_TAB[index_l] ) * 100 + 5) / 10 / (R100K_TAB[index_r] - R100K_TAB[index_l]);
        }
    }

    /******************温度补偿*********************/
    return temp;
}

/*
*****************************************************************
 * 函数原型：uint16_t Get_ADCVal(uint16_t temp)
 * 功    能：计算当前温度的adc值
 * 输    入：temp：当前温度
 * 输    出：ADC值
 * 参    数：uint16_t temp
*****************************************************************
*/

uint16_t Get_ADCVal(uint16_t temp)
{
	uint16_t adc,adc1;
	float val2;
	uint16_t val3,val1;
	
	val3 = (temp/10)+48;
	val2 = (float)(temp%10)/10;
	
	val1 = ((temp+10)/10)+47;
	
	adc = R100K_TAB[val3];
	adc1 = R100K_TAB[val1];
	return adc+((adc1-adc)*val2);
}

/*
*****************************************************************
 * 函数原型：void ADCDMA_Init(void)
 * 功    能：ADC和DMA的初始化
*****************************************************************
*/
void ADCDMA_Init(void)
{
    HAL_TIM_Base_Start_IT(&htim15);//开启TIM3的定时，用于刷新
	HAL_ADC_Start_DMA(&hadc,(uint32_t *)ADC_Val, AD_LEN);//用DMA获取adc值
	HAL_ADCEx_Calibration_Start(&hadc);
	for(uint8_t i=0;i<10;i++)
	{
		Temp.HEAT_GAI  = Get_Ntc_Temp(ADC_Val[1]);//计算温度
		Temp.Rel = Get_Ntc_Temp(ADC_Val[0]);//计算温度
		HAL_Delay(10);
	}
}

/* 
*****************************************************************
 * 函数原型：void Read_Temp(float dT)
 * 功    能：读取温度
*****************************************************************
*/
//uint16_t RelTemp_Old,AlarmTemp_Old;
void Read_Temp(float dT)
{
    static float T;
    T += dT;
	ADC_Val1 = Filter_ADC();//滤波获取adc的滑动平均值
	ADC_Val2 = Filter_ADC1();//滤波获取adc的滑动平均值

    if(T >= 0.2f)//1S
    {
//		RelTemp_Old = Temp.Rel;
//		AlarmTemp_Old = Temp.HEAT_GAI; 
		Temp.HEAT_GAI = Get_Ntc_Temp(ADC_Val2);//计算温度
		Temp.Rel = Get_Ntc_Temp(ADC_Val1);//计算温度
		T = 0;
    }
}
